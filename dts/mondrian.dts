/dts-v1/;

/*
 * Redmi K60 (mondrian) board description.
 *
 * The SM8475 CPUs, PSCI conduit and GICv3 window come from the SoC source; this
 * file adds what is specific to the board. The Apple identity and the OS
 * properties come from the OS profile's [adt] tables, and the payload handoff
 * options from board.toml [payload.adt].
 */

/include/ "sm8475.dtsi"

/ {
	model = "Redmi K60";
	compatible = "xiaomi,mondrian";

	/*
	 * This unit is the 16 GiB K60. Its DRAM is not one contiguous 16 GiB
	 * block: the low 2 GiB at 0x80000000 is followed by a hole, and the rest
	 * sits at 0x800000000 and above (see /proc/iomem). The ADT handoff needs
	 * exactly one contiguous range, so declare the low 2 GiB window that the
	 * payload and the kernel actually use.
	 *
	 * Must match board.toml [payload] dram_size.
	 */
	memory@80000000 {
		device_type = "memory";
		reg = <0x0 0x80000000 0x0 0x80000000>;
	};
};